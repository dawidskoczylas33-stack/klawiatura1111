/ {
    chosen {
        zmk,kscan = &kscan0;
    };

    kscan0: kscan {
        compatible = "zmk,kscan-gpio";

        col-gpios = <&gpio0 2 GPIO_ACTIVE_LOW>,
                    <&gpio0 3 GPIO_ACTIVE_LOW>,
                    <&gpio0 28 GPIO_ACTIVE_LOW>,
                    <&gpio0 29 GPIO_ACTIVE_LOW>;

        row-gpios = <>;
    };
};
